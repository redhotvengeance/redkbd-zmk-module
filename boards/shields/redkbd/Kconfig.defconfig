## boards/shields/redkbd/Kconfig.defconfig
```kconfig
if SHIELD_REDKBD_LEFT

config ZMK_KEYBOARD_NAME
    default "redkbd"

config ZMK_SPLIT_ROLE_CENTRAL
    default y

endif

if SHIELD_REDKBD_LEFT || SHIELD_REDKBD_RIGHT

config ZMK_SPLIT
    default y

endif
```

## boards/shields/redkbd/Kconfig.shield
```kconfig
config SHIELD_REDKBD_LEFT
    def_bool $(shields_list_contains,redkbd_left)

config SHIELD_REDKBD_RIGHT
    def_bool $(shields_list_contains,redkbd_right)
```
