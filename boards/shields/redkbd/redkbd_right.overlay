#include "redkbd.dtsi"

&default_transform {
    col-offset = <5>;
};

&kscan0 {
    diode-direction = "col2row";

    col-gpios
        = <&pro_micro 11 (GPIO_ACTIVE_HIGH)> // COL0
        , <&pro_micro 10 (GPIO_ACTIVE_HIGH)> // COL1
        , <&pro_micro 9 (GPIO_ACTIVE_HIGH)> // COL2
        , <&pro_micro 12 (GPIO_ACTIVE_HIGH)> // COL3
        , <&pro_micro 13 (GPIO_ACTIVE_HIGH)> // COL4
    ;
    row-gpios
        = <&pro_micro 2 (GPIO_ACTIVE_HIGH | GPIO_PULL_DOWN)> // ROW0
        , <&pro_micro 7 (GPIO_ACTIVE_HIGH | GPIO_PULL_DOWN)> // ROW1
        , <&pro_micro 8 (GPIO_ACTIVE_HIGH | GPIO_PULL_DOWN)> // ROW2
        , <&pro_micro 12 (GPIO_ACTIVE_HIGH | GPIO_PULL_DOWN)> // ROW3
    ;
};
